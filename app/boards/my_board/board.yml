## app/boards/my_board/board.yml
```yaml
board:
  name: my_board
  full_name: My board from scratch
  vendor: NPCC
  socs:
  - name: mcxa156
```

## app/boards/our_board/board.yml
```yaml
board:
  name: our_board
  full_name: Our Board
  vendor: NPCC
  socs:
  - name: mcxa156
```

## drivers/our_driver/Kconfig
```kconfig
config OUR_DRIVER
    bool "Our LED sensor driver"
    default y
    depends on DT_HAS_OUR_DRIVER_ENABLED
    depends on GPIO
    depends on SENSOR
```

## dts/bindings/our,driver.yaml
```yaml
description: Our LED sensor driver
compatible: "our,driver"
include: base.yaml

properties:
  gpios:
    type: phandle-array
    required: true
```

## twister-out.1/native_sim_native/host/homework.unit.ring_buf/Kconfig/boards/Kconfig.defconfig
```kconfig
# Load Zephyr board defconfig descriptions.
osource "/home/jose-figueroa/Documents/Zephyr/Iomico-course/deps/zephyr/boards/native/native_sim/Kconfig.defconfig"
```

## twister-out/native_sim_native/host/homework.unit.ring_buf/Kconfig/arch/Kconfig
```kconfig
# Load Zephyr Arch Kconfig descriptions.
osource "/home/jose-figueroa/Documents/Zephyr/Iomico-course/deps/zephyr/arch/rx/Kconfig"
osource "/home/jose-figueroa/Documents/Zephyr/Iomico-course/deps/zephyr/arch/x86/Kconfig"
osource "/home/jose-figueroa/Documents/Zephyr/Iomico-course/deps/zephyr/arch/xtensa/Kconfig"
osource "/home/jose-figueroa/Documents/Zephyr/Iomico-course/deps/zephyr/arch/sparc/Kconfig"
osource "/home/jose-figueroa/Documents/Zephyr/Iomico-course/deps/zephyr/arch/riscv/Kconfig"
osource "/home/jose-figueroa/Documents/Zephyr/Iomico-course/deps/zephyr/arch/posix/Kconfig"
osource "/home/jose-figueroa/Documents/Zephyr/Iomico-course/deps/zephyr/arch/mips/Kconfig"
osource "/home/jose-figueroa/Documents/Zephyr/Iomico-course/deps/zephyr/arch/arm64/Kconfig"
osource "/home/jose-figueroa/Documents/Zephyr/Iomico-course/deps/zephyr/arch/arm/Kconfig"
osource "/home/jose-figueroa/Documents/Zephyr/Iomico-course/deps/zephyr/arch/arc/Kconfig"
```

## twister-out/native_sim_native/host/homework.unit.ring_buf/Kconfig/boards/Kconfig
```kconfig
# Load Zephyr board Kconfig descriptions.
osource "/home/jose-figueroa/Documents/Zephyr/Iomico-course/deps/zephyr/boards/native/native_sim/Kconfig"
```
